/**
 * @cliArgs --device "CC3235SF" --package "Default" --part "Default" --ccxxImageMode --product "simplelink_cc32xx_sdk@6.10.00.05"
 * @versions {"tool":"1.12.0+2406"}
 */

/**
 * Import the modules used in this configuration.
 */
const General     = scripting.addModule("/ti/drivers/net/imagecreator/new_design/Device/General");
const Ota         = scripting.addModule("/ti/drivers/net/imagecreator/new_design/Device/Ota");
const Network     = scripting.addModule("/ti/drivers/net/imagecreator/new_design/NetworkServices/Network");
const CertStore   = scripting.addModule("/ti/drivers/net/imagecreator/new_design/UserFiles/CertStore");
const MCUImage    = scripting.addModule("/ti/drivers/net/imagecreator/new_design/UserFiles/MCUImage");
const ServicePack = scripting.addModule("/ti/drivers/net/imagecreator/new_design/UserFiles/ServicePack");
const fileTree    = scripting.addModule("/ti/drivers/net/imagecreator/new_design/UserFiles/fileTree");
const fileTree1   = fileTree.addInstance();
const Mac         = scripting.addModule("/ti/drivers/net/imagecreator/new_design/WiFi/Mac");
const Radio       = scripting.addModule("/ti/drivers/net/imagecreator/new_design/WiFi/Radio");

/**
 * Write custom configuration values to the imported modules.
 */
General.ModeSelect = "development";

Network.PRIM_PORT_SECURE_0    = true;
Network.ACCESS_ROM_1          = false;
Network.certHttpPrimFileInput = "userFiles/dummy-root-ca-cert";
Network.keyHttpPrimFileInput  = "userFiles/dummy-root-ca-cert-key";

fileTree.rootDirCfg = "userFiles";

fileTree1.$name       = "ti_drivers_net_imagecreator_new_design_UserFiles_fileTree0";
fileTree1.filePathCfg = scripting.forceWrite("dummy-root-ca-cert");

Mac.apipAddrText           = "192.168.0.1";
Mac.apdgText               = "192.168.0.1";
Mac.apDNSText              = "192.168.0.1";
Mac.apDhcpStartAddressText = "192.168.0.100";
Mac.apDhcpLastAddressText  = "192.168.0.249";

Radio.Is5GEnabledSelect = "0";
