/**
 * @cliArgs --board "/ti/boards/CC3235SF_LAUNCHXL" --rtos "freertos" --product "simplelink_cc32xx_sdk@6.10.00.05"
 * @versions {"tool":"1.12.0+2406"}
 */

/**
 * Import the modules used in this configuration.
 */
const GPIO           = scripting.addModule("/ti/drivers/GPIO");
const GPIO1          = GPIO.addInstance();
const Power          = scripting.addModule("/ti/drivers/Power");
const SPI            = scripting.addModule("/ti/drivers/SPI");
const UART           = scripting.addModule("/ti/drivers/UART", {}, false);
const UART1          = UART.addInstance();
const SimpleLinkWifi = scripting.addModule("/ti/drivers/net/wifi/SimpleLinkWifi");

/**
 * Write custom configuration values to the imported modules.
 */
GPIO1.$name     = "CONFIG_GPIO_LED_0";
GPIO1.$hardware = system.deviceData.board.components.LED_BLUE;

Power.parkPins.$name = "ti_drivers_power_PowerCC32XXPins0";

UART1.$name     = "CONFIG_UART_0";
UART1.$hardware = system.deviceData.board.components.XDS110UART;

SimpleLinkWifi.startRole = "AP";

/**
 * Pinmux solution for unlocked pins/peripherals. This ensures that minor changes to the automatic solver in a future
 * version of the tool will not impact the pinmux you originally saw.  These lines can be completely deleted in order to
 * re-solve from scratch.
 */
GPIO1.gpioPin.$suggestSolution    = "boosterpack.29";
UART1.uart.$suggestSolution       = "UART0";
UART1.uart.txPin.$suggestSolution = "ball.55";
UART1.uart.rxPin.$suggestSolution = "ball.57";
